/*
 * Generated by MTK SP Drv_CodeGen Version 03.13.6  for MT6735M. Copyright MediaTek Inc. (C) 2013.
 * Tue Jan  3 17:28:04 2017
 * Do Not Modify the File.
 */

/**********************************************
 *Keypad DTSI File
********************************************/

&keypad{
	KPD@ {
		compatible = "mediatek, kpd";
		kpd-key-debounce = <1024>;
		kpd-sw-pwrkey = <116>;
		kpd-hw-pwrkey = <8>;
		kpd-sw-rstkey  = <114>;
		kpd-hw-rstkey = <17>;
		kpd-use-extend-type = <0>;
		/*HW Keycode [0~71] -> Linux Keycode*/
		kpd-hw-init-map = <115 0 0 0 0 0 0 0 0 0 0 0 0 0 0 0 0 0 0 0 0 0 0 0 0 0 0 0 0 0 0 0 0 0 0 0 0 0 0 0 0 0 0 0 0 0 0 0 0 0 0 0 0 0 0 0 0 0 0 0 0 0 0 0 0 0 0 0 0 0 0 0 >;
		kpd-pwrkey-eint-gpio = <0>;
		kpd-pwkey-gpio-din  = <0>;
		kpd-hw-dl-key0 = <0>;
		kpd-hw-dl-key1 = <17>;
		kpd-hw-dl-key2 = <8>;
		/*****************************************************************/
		/*******************Uboot Customation***************************/
		/*****************************************************************/
		kpd-hw-recovery-key = <0>;
		kpd-hw-factory-key  = <17>;
	};
};
